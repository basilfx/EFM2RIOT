## dist-development/cpu/efm32/families/efr32fg14p/Kconfig
```kconfig
# Copyright (c) 2020 HAW Hamburg
#
# This file is subject to the terms and conditions of the GNU Lesser
# General Public License v2.1. See the file LICENSE in the top level
# directory for more details.

config CPU_FAM_EFR32FG14P
    bool
    select CPU_CORE_CORTEX_M4F
    select CPU_COMMON_EFM32
    select CPU_EFM32_SERIES1
    select HAS_PERIPH_HWRNG
    select HAS_CORTEXM_MPU

## CPU Models
config CPU_MODEL_EFR32FG14P232F256GM32
    bool
    select CPU_FAM_EFR32FG14P

config CPU_MODEL_EFR32FG14P231F256IM32
    bool
    select CPU_FAM_EFR32FG14P

config CPU_MODEL_EFR32FG14P231F256GM48
    bool
    select CPU_FAM_EFR32FG14P

config CPU_MODEL_EFR32FG14P231F128GM48
    bool
    select CPU_FAM_EFR32FG14P

config CPU_MODEL_EFR32FG14P232F128GM32
    bool
    select CPU_FAM_EFR32FG14P

config CPU_MODEL_EFR32FG14P232F128GM48
    bool
    select CPU_FAM_EFR32FG14P

config CPU_MODEL_EFR32FG14P231F128GM32
    bool
    select CPU_FAM_EFR32FG14P

config CPU_MODEL_EFR32FG14P233F256GM48
    bool
    select CPU_FAM_EFR32FG14P

config CPU_MODEL_EFR32FG14P231F256GM32
    bool
    select CPU_FAM_EFR32FG14P

config CPU_MODEL_EFR32FG14P233F128GM48
    bool
    select CPU_FAM_EFR32FG14P

config CPU_MODEL_EFR32FG14P231F256IM48
    bool
    select CPU_FAM_EFR32FG14P

config CPU_MODEL_EFR32FG14P232F256GM48
    bool
    select CPU_FAM_EFR32FG14P

## Common CPU symbols
config CPU_FAM
    default "efr32fg14p" if CPU_FAM_EFR32FG14P

config CPU_MODEL
    default "efr32fg14p232f256gm32" if CPU_MODEL_EFR32FG14P232F256GM32
    default "efr32fg14p231f256im32" if CPU_MODEL_EFR32FG14P231F256IM32
    default "efr32fg14p231f256gm48" if CPU_MODEL_EFR32FG14P231F256GM48
    default "efr32fg14p231f128gm48" if CPU_MODEL_EFR32FG14P231F128GM48
    default "efr32fg14p232f128gm32" if CPU_MODEL_EFR32FG14P232F128GM32
    default "efr32fg14p232f128gm48" if CPU_MODEL_EFR32FG14P232F128GM48
    default "efr32fg14p231f128gm32" if CPU_MODEL_EFR32FG14P231F128GM32
    default "efr32fg14p233f256gm48" if CPU_MODEL_EFR32FG14P233F256GM48
    default "efr32fg14p231f256gm32" if CPU_MODEL_EFR32FG14P231F256GM32
    default "efr32fg14p233f128gm48" if CPU_MODEL_EFR32FG14P233F128GM48
    default "efr32fg14p231f256im48" if CPU_MODEL_EFR32FG14P231F256IM48
    default "efr32fg14p232f256gm48" if CPU_MODEL_EFR32FG14P232F256GM48
```

## dist-development/cpu/efm32/families/efr32fg1p/Kconfig
```kconfig
# Copyright (c) 2020 HAW Hamburg
#
# This file is subject to the terms and conditions of the GNU Lesser
# General Public License v2.1. See the file LICENSE in the top level
# directory for more details.

config CPU_FAM_EFR32FG1P
    bool
    select CPU_CORE_CORTEX_M4F
    select CPU_COMMON_EFM32

## CPU Models
config CPU_MODEL_EFR32FG1P132F128GM32
    bool
    select CPU_FAM_EFR32FG1P

config CPU_MODEL_EFR32FG1P131F128GM48
    bool
    select CPU_FAM_EFR32FG1P

config CPU_MODEL_EFR32FG1P133F64GM48
    bool
    select CPU_FAM_EFR32FG1P

config CPU_MODEL_EFR32FG1P132F64GM48
    bool
    select CPU_FAM_EFR32FG1P

config CPU_MODEL_EFR32FG1P133F256GM32
    bool
    select CPU_FAM_EFR32FG1P

config CPU_MODEL_EFR32FG1P131F256GM48
    bool
    select CPU_FAM_EFR32FG1P

config CPU_MODEL_EFR32FG1P131F64GM32
    bool
    select CPU_FAM_EFR32FG1P

config CPU_MODEL_EFR32FG1P132F256GM32
    bool
    select CPU_FAM_EFR32FG1P

config CPU_MODEL_EFR32FG1P131F256IM32
    bool
    select CPU_FAM_EFR32FG1P

config CPU_MODEL_EFR32FG1P131F256IM48
    bool
    select CPU_FAM_EFR32FG1P

config CPU_MODEL_EFR32FG1P132F256GM48
    bool
    select CPU_FAM_EFR32FG1P

config CPU_MODEL_EFR32FG1P131F64GM48
    bool
    select CPU_FAM_EFR32FG1P

config CPU_MODEL_EFR32FG1P131F256GM32
    bool
    select CPU_FAM_EFR32FG1P

config CPU_MODEL_EFR32FG1P133F128GM48
    bool
    select CPU_FAM_EFR32FG1P

config CPU_MODEL_EFR32FG1P131F128GM32
    bool
    select CPU_FAM_EFR32FG1P

config CPU_MODEL_EFR32FG1P133F256GM48
    bool
    select CPU_FAM_EFR32FG1P

config CPU_MODEL_EFR32FG1P132F64GM32
    bool
    select CPU_FAM_EFR32FG1P

config CPU_MODEL_EFR32FG1P132F128GM48
    bool
    select CPU_FAM_EFR32FG1P

## Common CPU symbols
config CPU_FAM
    default "efr32fg1p" if CPU_FAM_EFR32FG1P

config CPU_MODEL
    default "efr32fg1p132f128gm32" if CPU_MODEL_EFR32FG1P132F128GM32
    default "efr32fg1p131f128gm48" if CPU_MODEL_EFR32FG1P131F128GM48
    default "efr32fg1p133f64gm48"  if CPU_MODEL_EFR32FG1P133F64GM48
    default "efr32fg1p132f64gm48"  if CPU_MODEL_EFR32FG1P132F64GM48
    default "efr32fg1p133f256gm32" if CPU_MODEL_EFR32FG1P133F256GM32
    default "efr32fg1p131f256gm48" if CPU_MODEL_EFR32FG1P131F256GM48
    default "efr32fg1p131f64gm32"  if CPU_MODEL_EFR32FG1P131F64GM32
    default "efr32fg1p132f256gm32" if CPU_MODEL_EFR32FG1P132F256GM32
    default "efr32fg1p131f256im32" if CPU_MODEL_EFR32FG1P131F256IM32
    default "efr32fg1p131f256im48" if CPU_MODEL_EFR32FG1P131F256IM48
    default "efr32fg1p132f256gm48" if CPU_MODEL_EFR32FG1P132F256GM48
    default "efr32fg1p131f64gm48"  if CPU_MODEL_EFR32FG1P131F64GM48
    default "efr32fg1p131f256gm32" if CPU_MODEL_EFR32FG1P131F256GM32
    default "efr32fg1p133f128gm48" if CPU_MODEL_EFR32FG1P133F128GM48
    default "efr32fg1p131f128gm32" if CPU_MODEL_EFR32FG1P131F128GM32
    default "efr32fg1p133f256gm48" if CPU_MODEL_EFR32FG1P133F256GM48
    default "efr32fg1p132f64gm32"  if CPU_MODEL_EFR32FG1P132F64GM32
    default "efr32fg1p132f128gm48" if CPU_MODEL_EFR32FG1P132F128GM48
```

## dist-development/cpu/efm32/families/efr32fg1v/Kconfig
```kconfig
# Copyright (c) 2020 HAW Hamburg
#
# This file is subject to the terms and conditions of the GNU Lesser
# General Public License v2.1. See the file LICENSE in the top level
# directory for more details.

config CPU_FAM_EFR32FG1V
    bool
    select CPU_CORE_CORTEX_M4F
    select CPU_COMMON_EFM32

## CPU Models
config CPU_MODEL_EFR32FG1V131F32GM48
    bool
    select CPU_FAM_EFR32FG1V

config CPU_MODEL_EFR32FG1V131F128GM48
    bool
    select CPU_FAM_EFR32FG1V

config CPU_MODEL_EFR32FG1V131F64GM32
    bool
    select CPU_FAM_EFR32FG1V

config CPU_MODEL_EFR32FG1V132F128GM32
    bool
    select CPU_FAM_EFR32FG1V

config CPU_MODEL_EFR32FG1V232F256GM32
    bool
    select CPU_FAM_EFR32FG1V

config CPU_MODEL_EFR32FG1V132F32GM32
    bool
    select CPU_FAM_EFR32FG1V

config CPU_MODEL_EFR32FG1V132F256GM32
    bool
    select CPU_FAM_EFR32FG1V

config CPU_MODEL_EFR32FG1V132F64GM48
    bool
    select CPU_FAM_EFR32FG1V

config CPU_MODEL_EFR32FG1V131F256GM48
    bool
    select CPU_FAM_EFR32FG1V

config CPU_MODEL_EFR32FG1V131F256GM32
    bool
    select CPU_FAM_EFR32FG1V

config CPU_MODEL_EFR32FG1V032F128GM32
    bool
    select CPU_FAM_EFR32FG1V

config CPU_MODEL_EFR32FG1V132F64GM32
    bool
    select CPU_FAM_EFR32FG1V

config CPU_MODEL_EFR32FG1V132F256GM48
    bool
    select CPU_FAM_EFR32FG1V

config CPU_MODEL_EFR32FG1V132F32GM48
    bool
    select CPU_FAM_EFR32FG1V

config CPU_MODEL_EFR32FG1V132F128GM48
    bool
    select CPU_FAM_EFR32FG1V

config CPU_MODEL_EFR32FG1V232F256GM48
    bool
    select CPU_FAM_EFR32FG1V

config CPU_MODEL_EFR32FG1V131F64GM48
    bool
    select CPU_FAM_EFR32FG1V

config CPU_MODEL_EFR32FG1V131F32GM32
    bool
    select CPU_FAM_EFR32FG1V

config CPU_MODEL_EFR32FG1V032F256GM32
    bool
    select CPU_FAM_EFR32FG1V

config CPU_MODEL_EFR32FG1V131F128GM32
    bool
    select CPU_FAM_EFR32FG1V

## Common CPU symbols
config CPU_FAM
    default "efr32fg1v" if CPU_FAM_EFR32FG1V

config CPU_MODEL
    default "efr32fg1v131f32gm48"  if CPU_MODEL_EFR32FG1V131F32GM48
    default "efr32fg1v131f128gm48" if CPU_MODEL_EFR32FG1V131F128GM48
    default "efr32fg1v131f64gm32"  if CPU_MODEL_EFR32FG1V131F64GM32
    default "efr32fg1v132f128gm32" if CPU_MODEL_EFR32FG1V132F128GM32
    default "efr32fg1v232f256gm32" if CPU_MODEL_EFR32FG1V232F256GM32
    default "efr32fg1v132f32gm32"  if CPU_MODEL_EFR32FG1V132F32GM32
    default "efr32fg1v132f256gm32" if CPU_MODEL_EFR32FG1V132F256GM32
    default "efr32fg1v132f64gm48"  if CPU_MODEL_EFR32FG1V132F64GM48
    default "efr32fg1v131f256gm48" if CPU_MODEL_EFR32FG1V131F256GM48
    default "efr32fg1v131f256gm32" if CPU_MODEL_EFR32FG1V131F256GM32
    default "efr32fg1v032f128gm32" if CPU_MODEL_EFR32FG1V032F128GM32
    default "efr32fg1v132f64gm32"  if CPU_MODEL_EFR32FG1V132F64GM32
    default "efr32fg1v132f256gm48" if CPU_MODEL_EFR32FG1V132F256GM48
    default "efr32fg1v132f32gm48"  if CPU_MODEL_EFR32FG1V132F32GM48
    default "efr32fg1v132f128gm48" if CPU_MODEL_EFR32FG1V132F128GM48
    default "efr32fg1v232f256gm48" if CPU_MODEL_EFR32FG1V232F256GM48
    default "efr32fg1v131f64gm48"  if CPU_MODEL_EFR32FG1V131F64GM48
    default "efr32fg1v131f32gm32"  if CPU_MODEL_EFR32FG1V131F32GM32
    default "efr32fg1v032f256gm32" if CPU_MODEL_EFR32FG1V032F256GM32
    default "efr32fg1v131f128gm32" if CPU_MODEL_EFR32FG1V131F128GM32
```

## dist-development/cpu/efm32/families/efr32fg22/Kconfig
```kconfig
# Copyright (c) 2020 HAW Hamburg
#
# This file is subject to the terms and conditions of the GNU Lesser
# General Public License v2.1. See the file LICENSE in the top level
# directory for more details.

config CPU_FAM_EFR32FG22
    bool
    select CPU_CORE_CORTEX_M33
    select CPU_COMMON_EFM32
    select HAS_PERIPH_HWRNG

## CPU Models
config CPU_MODEL_EFR32FG22C121F512GM32
    bool
    select CPU_FAM_EFR32FG22

config CPU_MODEL_EFR32FG22C121F512GM40
    bool
    select CPU_FAM_EFR32FG22

config CPU_MODEL_EFR32FG22C121F256GM40
    bool
    select CPU_FAM_EFR32FG22

config CPU_MODEL_EFR32FG22C121F256GM32
    bool
    select CPU_FAM_EFR32FG22

## Common CPU symbols
config CPU_FAM
    default "efr32fg22" if CPU_FAM_EFR32FG22

config CPU_MODEL
    default "efr32fg22c121f512gm32" if CPU_MODEL_EFR32FG22C121F512GM32
    default "efr32fg22c121f512gm40" if CPU_MODEL_EFR32FG22C121F512GM40
    default "efr32fg22c121f256gm40" if CPU_MODEL_EFR32FG22C121F256GM40
    default "efr32fg22c121f256gm32" if CPU_MODEL_EFR32FG22C121F256GM32
```

## dist-development/cpu/efm32/families/ezr32hg/Kconfig
```kconfig
# Copyright (c) 2020 HAW Hamburg
#
# This file is subject to the terms and conditions of the GNU Lesser
# General Public License v2.1. See the file LICENSE in the top level
# directory for more details.

config CPU_FAM_EZR32HG
    bool
    select CPU_CORE_CORTEX_M0PLUS
    select CPU_COMMON_EFM32
    select CPU_EFM32_SERIES0

## CPU Models
config CPU_MODEL_EZR32HG320F32R61
    bool
    select CPU_FAM_EZR32HG

config CPU_MODEL_EZR32HG220F32R68
    bool
    select CPU_FAM_EZR32HG

config CPU_MODEL_EZR32HG220F64R68
    bool
    select CPU_FAM_EZR32HG

config CPU_MODEL_EZR32HG320F64R61
    bool
    select CPU_FAM_EZR32HG

config CPU_MODEL_EZR32HG220F32R61
    bool
    select CPU_FAM_EZR32HG

config CPU_MODEL_EZR32HG320F32R68
    bool
    select CPU_FAM_EZR32HG

config CPU_MODEL_EZR32HG320F64R68
    bool
    select CPU_FAM_EZR32HG

config CPU_MODEL_EZR32HG220F64R61
    bool
    select CPU_FAM_EZR32HG

config CPU_MODEL_EZR32HG320F32R67
    bool
    select CPU_FAM_EZR32HG

config CPU_MODEL_EZR32HG220F32R60
    bool
    select CPU_FAM_EZR32HG

config CPU_MODEL_EZR32HG220F64R55
    bool
    select CPU_FAM_EZR32HG

config CPU_MODEL_EZR32HG320F32R69
    bool
    select CPU_FAM_EZR32HG

config CPU_MODEL_EZR32HG320F32R63
    bool
    select CPU_FAM_EZR32HG

config CPU_MODEL_EZR32HG320F64R63
    bool
    select CPU_FAM_EZR32HG

config CPU_MODEL_EZR32HG320F64R69
    bool
    select CPU_FAM_EZR32HG

config CPU_MODEL_EZR32HG220F32R55
    bool
    select CPU_FAM_EZR32HG

config CPU_MODEL_EZR32HG220F64R60
    bool
    select CPU_FAM_EZR32HG

config CPU_MODEL_EZR32HG320F64R67
    bool
    select CPU_FAM_EZR32HG

config CPU_MODEL_EZR32HG220F32R67
    bool
    select CPU_FAM_EZR32HG

config CPU_MODEL_EZR32HG320F64R55
    bool
    select CPU_FAM_EZR32HG

config CPU_MODEL_EZR32HG320F32R60
    bool
    select CPU_FAM_EZR32HG

config CPU_MODEL_EZR32HG220F32R63
    bool
    select CPU_FAM_EZR32HG

config CPU_MODEL_EZR32HG220F32R69
    bool
    select CPU_FAM_EZR32HG

config CPU_MODEL_EZR32HG220F64R69
    bool
    select CPU_FAM_EZR32HG

config CPU_MODEL_EZR32HG220F64R63
    bool
    select CPU_FAM_EZR32HG

config CPU_MODEL_EZR32HG320F64R60
    bool
    select CPU_FAM_EZR32HG

config CPU_MODEL_EZR32HG320F32R55
    bool
    select CPU_FAM_EZR32HG

config CPU_MODEL_EZR32HG220F64R67
    bool
    select CPU_FAM_EZR32HG

## Common CPU symbols
config CPU_FAM
    default "ezr32hg" if CPU_FAM_EZR32HG

config CPU_MODEL
    default "ezr32hg320f32r61" if CPU_MODEL_EZR32HG320F32R61
    default "ezr32hg220f32r68" if CPU_MODEL_EZR32HG220F32R68
    default "ezr32hg220f64r68" if CPU_MODEL_EZR32HG220F64R68
    default "ezr32hg320f64r61" if CPU_MODEL_EZR32HG320F64R61
    default "ezr32hg220f32r61" if CPU_MODEL_EZR32HG220F32R61
    default "ezr32hg320f32r68" if CPU_MODEL_EZR32HG320F32R68
    default "ezr32hg320f64r68" if CPU_MODEL_EZR32HG320F64R68
    default "ezr32hg220f64r61" if CPU_MODEL_EZR32HG220F64R61
    default "ezr32hg320f32r67" if CPU_MODEL_EZR32HG320F32R67
    default "ezr32hg220f32r60" if CPU_MODEL_EZR32HG220F32R60
    default "ezr32hg220f64r55" if CPU_MODEL_EZR32HG220F64R55
    default "ezr32hg320f32r69" if CPU_MODEL_EZR32HG320F32R69
    default "ezr32hg320f32r63" if CPU_MODEL_EZR32HG320F32R63
    default "ezr32hg320f64r63" if CPU_MODEL_EZR32HG320F64R63
    default "ezr32hg320f64r69" if CPU_MODEL_EZR32HG320F64R69
    default "ezr32hg220f32r55" if CPU_MODEL_EZR32HG220F32R55
    default "ezr32hg220f64r60" if CPU_MODEL_EZR32HG220F64R60
    default "ezr32hg320f64r67" if CPU_MODEL_EZR32HG320F64R67
    default "ezr32hg220f32r67" if CPU_MODEL_EZR32HG220F32R67
    default "ezr32hg320f64r55" if CPU_MODEL_EZR32HG320F64R55
    default "ezr32hg320f32r60" if CPU_MODEL_EZR32HG320F32R60
    default "ezr32hg220f32r63" if CPU_MODEL_EZR32HG220F32R63
    default "ezr32hg220f32r69" if CPU_MODEL_EZR32HG220F32R69
    default "ezr32hg220f64r69" if CPU_MODEL_EZR32HG220F64R69
    default "ezr32hg220f64r63" if CPU_MODEL_EZR32HG220F64R63
    default "ezr32hg320f64r60" if CPU_MODEL_EZR32HG320F64R60
    default "ezr32hg320f32r55" if CPU_MODEL_EZR32HG320F32R55
    default "ezr32hg220f64r67" if CPU_MODEL_EZR32HG220F64R67
```
