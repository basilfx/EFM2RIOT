## dist/cpu/efm32/families/efr32bg21/Kconfig
```kconfig
# Copyright (c) 2020 HAW Hamburg
#
# This file is subject to the terms and conditions of the GNU Lesser
# General Public License v2.1. See the file LICENSE in the top level
# directory for more details.

config CPU_FAM_EFR32BG21
    bool
    select CPU_CORE_CORTEX_M33
    select CPU_COMMON_EFM32
    select CPU_EFM32_SERIES2
    select HAS_PERIPH_HWRNG
    select HAS_CORTEXM_MPU

## CPU Models
config CPU_MODEL_EFR32BG21B020F512IM32
    bool
    select CPU_FAM_EFR32BG21

config CPU_MODEL_EFR32BG21A010F512IM32
    bool
    select CPU_FAM_EFR32BG21

config CPU_MODEL_EFR32BG21A010F768IM32
    bool
    select CPU_FAM_EFR32BG21

config CPU_MODEL_EFR32BG21B020F768IM32
    bool
    select CPU_FAM_EFR32BG21

config CPU_MODEL_EFR32BG21B020F1024IM32
    bool
    select CPU_FAM_EFR32BG21

config CPU_MODEL_EFR32BG21B010F768IM32
    bool
    select CPU_FAM_EFR32BG21

config CPU_MODEL_EFR32BG21A020F1024IM32
    bool
    select CPU_FAM_EFR32BG21

config CPU_MODEL_EFR32BG21A020F768IM32
    bool
    select CPU_FAM_EFR32BG21

config CPU_MODEL_EFR32BG21A020F512IM32
    bool
    select CPU_FAM_EFR32BG21

config CPU_MODEL_EFR32BG21A010F1024IM32
    bool
    select CPU_FAM_EFR32BG21

config CPU_MODEL_EFR32BG21B010F512IM32
    bool
    select CPU_FAM_EFR32BG21

config CPU_MODEL_EFR32BG21B010F1024IM32
    bool
    select CPU_FAM_EFR32BG21

## Common CPU symbols
config CPU_FAM
    default "efr32bg21" if CPU_FAM_EFR32BG21

config CPU_MODEL
    default "efr32bg21b020f512im32"  if CPU_MODEL_EFR32BG21B020F512IM32
    default "efr32bg21a010f512im32"  if CPU_MODEL_EFR32BG21A010F512IM32
    default "efr32bg21a010f768im32"  if CPU_MODEL_EFR32BG21A010F768IM32
    default "efr32bg21b020f768im32"  if CPU_MODEL_EFR32BG21B020F768IM32
    default "efr32bg21b020f1024im32" if CPU_MODEL_EFR32BG21B020F1024IM32
    default "efr32bg21b010f768im32"  if CPU_MODEL_EFR32BG21B010F768IM32
    default "efr32bg21a020f1024im32" if CPU_MODEL_EFR32BG21A020F1024IM32
    default "efr32bg21a020f768im32"  if CPU_MODEL_EFR32BG21A020F768IM32
    default "efr32bg21a020f512im32"  if CPU_MODEL_EFR32BG21A020F512IM32
    default "efr32bg21a010f1024im32" if CPU_MODEL_EFR32BG21A010F1024IM32
    default "efr32bg21b010f512im32"  if CPU_MODEL_EFR32BG21B010F512IM32
    default "efr32bg21b010f1024im32" if CPU_MODEL_EFR32BG21B010F1024IM32
```

## dist/cpu/efm32/families/efr32bg22/Kconfig
```kconfig
# Copyright (c) 2020 HAW Hamburg
#
# This file is subject to the terms and conditions of the GNU Lesser
# General Public License v2.1. See the file LICENSE in the top level
# directory for more details.

config CPU_FAM_EFR32BG22
    bool
    select CPU_CORE_CORTEX_M33
    select CPU_COMMON_EFM32
    select CPU_EFM32_SERIES2
    select HAS_PERIPH_HWRNG
    select HAS_CORTEXM_MPU

## CPU Models
config CPU_MODEL_EFR32BG22C224F512IM40
    bool
    select CPU_FAM_EFR32BG22

config CPU_MODEL_EFR32BG22C222F352GM40
    bool
    select CPU_FAM_EFR32BG22

config CPU_MODEL_EFR32BG22C222F352GM32
    bool
    select CPU_FAM_EFR32BG22

config CPU_MODEL_EFR32BG22C222F352GN32
    bool
    select CPU_FAM_EFR32BG22

config CPU_MODEL_EFR32BG22C224F512IM32
    bool
    select CPU_FAM_EFR32BG22

config CPU_MODEL_EFR32BG22C224F512GM32
    bool
    select CPU_FAM_EFR32BG22

config CPU_MODEL_EFR32BG22C224F512GN32
    bool
    select CPU_FAM_EFR32BG22

config CPU_MODEL_EFR32BG22C224F512GM40
    bool
    select CPU_FAM_EFR32BG22

config CPU_MODEL_EFR32BG22C112F352GM32
    bool
    select CPU_FAM_EFR32BG22

## Common CPU symbols
config CPU_FAM
    default "efr32bg22" if CPU_FAM_EFR32BG22

config CPU_MODEL
    default "efr32bg22c224f512im40" if CPU_MODEL_EFR32BG22C224F512IM40
    default "efr32bg22c222f352gm40" if CPU_MODEL_EFR32BG22C222F352GM40
    default "efr32bg22c222f352gm32" if CPU_MODEL_EFR32BG22C222F352GM32
    default "efr32bg22c222f352gn32" if CPU_MODEL_EFR32BG22C222F352GN32
    default "efr32bg22c224f512im32" if CPU_MODEL_EFR32BG22C224F512IM32
    default "efr32bg22c224f512gm32" if CPU_MODEL_EFR32BG22C224F512GM32
    default "efr32bg22c224f512gn32" if CPU_MODEL_EFR32BG22C224F512GN32
    default "efr32bg22c224f512gm40" if CPU_MODEL_EFR32BG22C224F512GM40
    default "efr32bg22c112f352gm32" if CPU_MODEL_EFR32BG22C112F352GM32
```

## dist/cpu/efm32/families/efr32fg13p/Kconfig
```kconfig
# Copyright (c) 2020 HAW Hamburg
#
# This file is subject to the terms and conditions of the GNU Lesser
# General Public License v2.1. See the file LICENSE in the top level
# directory for more details.

config CPU_FAM_EFR32FG13P
    bool
    select CPU_CORE_CORTEX_M4F
    select CPU_COMMON_EFM32
    select CPU_EFM32_SERIES1
    select HAS_PERIPH_HWRNG
    select HAS_CORTEXM_MPU

## CPU Models
config CPU_MODEL_EFR32FG13P232F512GM48
    bool
    select CPU_FAM_EFR32FG13P

config CPU_MODEL_EFR32FG13P231F512IM48
    bool
    select CPU_FAM_EFR32FG13P

config CPU_MODEL_EFR32FG13P231F512GM32
    bool
    select CPU_FAM_EFR32FG13P

config CPU_MODEL_EFR32FG13P233F512GM48
    bool
    select CPU_FAM_EFR32FG13P

config CPU_MODEL_EFR32FG13P231F512GM48
    bool
    select CPU_FAM_EFR32FG13P

config CPU_MODEL_EFR32FG13P231F512IM32
    bool
    select CPU_FAM_EFR32FG13P

config CPU_MODEL_EFR32FG13P232F512GM32
    bool
    select CPU_FAM_EFR32FG13P

## Common CPU symbols
config CPU_FAM
    default "efr32fg13p" if CPU_FAM_EFR32FG13P

config CPU_MODEL
    default "efr32fg13p232f512gm48" if CPU_MODEL_EFR32FG13P232F512GM48
    default "efr32fg13p231f512im48" if CPU_MODEL_EFR32FG13P231F512IM48
    default "efr32fg13p231f512gm32" if CPU_MODEL_EFR32FG13P231F512GM32
    default "efr32fg13p233f512gm48" if CPU_MODEL_EFR32FG13P233F512GM48
    default "efr32fg13p231f512gm48" if CPU_MODEL_EFR32FG13P231F512GM48
    default "efr32fg13p231f512im32" if CPU_MODEL_EFR32FG13P231F512IM32
    default "efr32fg13p232f512gm32" if CPU_MODEL_EFR32FG13P232F512GM32
```

## dist/cpu/efm32/families/efr32fg14v/Kconfig
```kconfig
# Copyright (c) 2020 HAW Hamburg
#
# This file is subject to the terms and conditions of the GNU Lesser
# General Public License v2.1. See the file LICENSE in the top level
# directory for more details.

config CPU_FAM_EFR32FG14V
    bool
    select CPU_CORE_CORTEX_M4F
    select CPU_COMMON_EFM32
    select HAS_PERIPH_HWRNG

## CPU Models
config CPU_MODEL_EFR32FG14V132F256GM32
    bool
    select CPU_FAM_EFR32FG14V

config CPU_MODEL_EFR32FG14V132F256GM48
    bool
    select CPU_FAM_EFR32FG14V

## Common CPU symbols
config CPU_FAM
    default "efr32fg14v" if CPU_FAM_EFR32FG14V

config CPU_MODEL
    default "efr32fg14v132f256gm32" if CPU_MODEL_EFR32FG14V132F256GM32
    default "efr32fg14v132f256gm48" if CPU_MODEL_EFR32FG14V132F256GM48
```

## dist/cpu/efm32/families/efr32mg13p/Kconfig
```kconfig
# Copyright (c) 2020 HAW Hamburg
#
# This file is subject to the terms and conditions of the GNU Lesser
# General Public License v2.1. See the file LICENSE in the top level
# directory for more details.

config CPU_FAM_EFR32MG13P
    bool
    select CPU_CORE_CORTEX_M4F
    select CPU_COMMON_EFM32
    select HAS_PERIPH_HWRNG

## CPU Models
config CPU_MODEL_EFR32MG13P732F512IM32
    bool
    select CPU_FAM_EFR32MG13P

config CPU_MODEL_EFR32MG13P732F512GM48
    bool
    select CPU_FAM_EFR32MG13P

config CPU_MODEL_EFR32MG13P732F512GM51
    bool
    select CPU_FAM_EFR32MG13P

config CPU_MODEL_EFR32MG13P632F512GM32
    bool
    select CPU_FAM_EFR32MG13P

config CPU_MODEL_EFR32MG13P733F512GM48
    bool
    select CPU_FAM_EFR32MG13P

config CPU_MODEL_EFR32MG13P632F512GM48
    bool
    select CPU_FAM_EFR32MG13P

config CPU_MODEL_EFR32MG13P832F512IM48
    bool
    select CPU_FAM_EFR32MG13P

config CPU_MODEL_EFR32MG13P733F512IM48
    bool
    select CPU_FAM_EFR32MG13P

config CPU_MODEL_EFR32MG13P732F512GM32
    bool
    select CPU_FAM_EFR32MG13P

config CPU_MODEL_EFR32MG13P731F512GM48
    bool
    select CPU_FAM_EFR32MG13P

config CPU_MODEL_EFR32MG13P632F512GM51
    bool
    select CPU_FAM_EFR32MG13P

config CPU_MODEL_EFR32MG13P732F512IM48
    bool
    select CPU_FAM_EFR32MG13P

## Common CPU symbols
config CPU_FAM
    default "efr32mg13p" if CPU_FAM_EFR32MG13P

config CPU_MODEL
    default "efr32mg13p732f512im32" if CPU_MODEL_EFR32MG13P732F512IM32
    default "efr32mg13p732f512gm48" if CPU_MODEL_EFR32MG13P732F512GM48
    default "efr32mg13p732f512gm51" if CPU_MODEL_EFR32MG13P732F512GM51
    default "efr32mg13p632f512gm32" if CPU_MODEL_EFR32MG13P632F512GM32
    default "efr32mg13p733f512gm48" if CPU_MODEL_EFR32MG13P733F512GM48
    default "efr32mg13p632f512gm48" if CPU_MODEL_EFR32MG13P632F512GM48
    default "efr32mg13p832f512im48" if CPU_MODEL_EFR32MG13P832F512IM48
    default "efr32mg13p733f512im48" if CPU_MODEL_EFR32MG13P733F512IM48
    default "efr32mg13p732f512gm32" if CPU_MODEL_EFR32MG13P732F512GM32
    default "efr32mg13p731f512gm48" if CPU_MODEL_EFR32MG13P731F512GM48
    default "efr32mg13p632f512gm51" if CPU_MODEL_EFR32MG13P632F512GM51
    default "efr32mg13p732f512im48" if CPU_MODEL_EFR32MG13P732F512IM48
```

## dist/cpu/efm32/families/efr32mg14p/Kconfig
```kconfig
# Copyright (c) 2020 HAW Hamburg
#
# This file is subject to the terms and conditions of the GNU Lesser
# General Public License v2.1. See the file LICENSE in the top level
# directory for more details.

config CPU_FAM_EFR32MG14P
    bool
    select CPU_CORE_CORTEX_M4F
    select CPU_COMMON_EFM32
    select HAS_PERIPH_HWRNG

## CPU Models
config CPU_MODEL_EFR32MG14P732F256IM48
    bool
    select CPU_FAM_EFR32MG14P

config CPU_MODEL_EFR32MG14P731F256GM48
    bool
    select CPU_FAM_EFR32MG14P

config CPU_MODEL_EFR32MG14P732F256GM32
    bool
    select CPU_FAM_EFR32MG14P

config CPU_MODEL_EFR32MG14P733F256IM48
    bool
    select CPU_FAM_EFR32MG14P

config CPU_MODEL_EFR32MG14P632F256GM48
    bool
    select CPU_FAM_EFR32MG14P

config CPU_MODEL_EFR32MG14P632F256GM32
    bool
    select CPU_FAM_EFR32MG14P

config CPU_MODEL_EFR32MG14P733F256GM48
    bool
    select CPU_FAM_EFR32MG14P

config CPU_MODEL_EFR32MG14P732F256GM48
    bool
    select CPU_FAM_EFR32MG14P

config CPU_MODEL_EFR32MG14P732F256IM32
    bool
    select CPU_FAM_EFR32MG14P

## Common CPU symbols
config CPU_FAM
    default "efr32mg14p" if CPU_FAM_EFR32MG14P

config CPU_MODEL
    default "efr32mg14p732f256im48" if CPU_MODEL_EFR32MG14P732F256IM48
    default "efr32mg14p731f256gm48" if CPU_MODEL_EFR32MG14P731F256GM48
    default "efr32mg14p732f256gm32" if CPU_MODEL_EFR32MG14P732F256GM32
    default "efr32mg14p733f256im48" if CPU_MODEL_EFR32MG14P733F256IM48
    default "efr32mg14p632f256gm48" if CPU_MODEL_EFR32MG14P632F256GM48
    default "efr32mg14p632f256gm32" if CPU_MODEL_EFR32MG14P632F256GM32
    default "efr32mg14p733f256gm48" if CPU_MODEL_EFR32MG14P733F256GM48
    default "efr32mg14p732f256gm48" if CPU_MODEL_EFR32MG14P732F256GM48
    default "efr32mg14p732f256im32" if CPU_MODEL_EFR32MG14P732F256IM32
```

## dist/cpu/efm32/families/efr32mg1v/Kconfig
```kconfig
# Copyright (c) 2020 HAW Hamburg
#
# This file is subject to the terms and conditions of the GNU Lesser
# General Public License v2.1. See the file LICENSE in the top level
# directory for more details.

config CPU_FAM_EFR32MG1V
    bool
    select CPU_CORE_CORTEX_M4F
    select CPU_COMMON_EFM32

## CPU Models
config CPU_MODEL_EFR32MG1V131F256GM32
    bool
    select CPU_FAM_EFR32MG1V

config CPU_MODEL_EFR32MG1V132F256GM48
    bool
    select CPU_FAM_EFR32MG1V

config CPU_MODEL_EFR32MG1V132F256GM32
    bool
    select CPU_FAM_EFR32MG1V

config CPU_MODEL_EFR32MG1V131F256GM48
    bool
    select CPU_FAM_EFR32MG1V

## Common CPU symbols
config CPU_FAM
    default "efr32mg1v" if CPU_FAM_EFR32MG1V

config CPU_MODEL
    default "efr32mg1v131f256gm32" if CPU_MODEL_EFR32MG1V131F256GM32
    default "efr32mg1v132f256gm48" if CPU_MODEL_EFR32MG1V132F256GM48
    default "efr32mg1v132f256gm32" if CPU_MODEL_EFR32MG1V132F256GM32
    default "efr32mg1v131f256gm48" if CPU_MODEL_EFR32MG1V131F256GM48
```

## dist/cpu/efm32/families/efr32mg22/Kconfig
```kconfig
# Copyright (c) 2020 HAW Hamburg
#
# This file is subject to the terms and conditions of the GNU Lesser
# General Public License v2.1. See the file LICENSE in the top level
# directory for more details.

config CPU_FAM_EFR32MG22
    bool
    select CPU_CORE_CORTEX_M33
    select CPU_COMMON_EFM32
    select HAS_PERIPH_HWRNG

## CPU Models
config CPU_MODEL_EFR32MG22C224F512IM40
    bool
    select CPU_FAM_EFR32MG22

config CPU_MODEL_EFR32MG22C224F512IM32
    bool
    select CPU_FAM_EFR32MG22

config CPU_MODEL_EFR32MG22C224F512GN32
    bool
    select CPU_FAM_EFR32MG22

config CPU_MODEL_EFR32MG22A224F512IM40
    bool
    select CPU_FAM_EFR32MG22

## Common CPU symbols
config CPU_FAM
    default "efr32mg22" if CPU_FAM_EFR32MG22

config CPU_MODEL
    default "efr32mg22c224f512im40" if CPU_MODEL_EFR32MG22C224F512IM40
    default "efr32mg22c224f512im32" if CPU_MODEL_EFR32MG22C224F512IM32
    default "efr32mg22c224f512gn32" if CPU_MODEL_EFR32MG22C224F512GN32
    default "efr32mg22a224f512im40" if CPU_MODEL_EFR32MG22A224F512IM40
```

## dist/cpu/efm32/families/efr32zg13p/Kconfig
```kconfig
# Copyright (c) 2020 HAW Hamburg
#
# This file is subject to the terms and conditions of the GNU Lesser
# General Public License v2.1. See the file LICENSE in the top level
# directory for more details.

config CPU_FAM_EFR32ZG13P
    bool
    select CPU_CORE_CORTEX_M4F
    select CPU_COMMON_EFM32
    select CPU_EFM32_SERIES1
    select HAS_PERIPH_HWRNG
    select HAS_CORTEXM_MPU

## CPU Models
config CPU_MODEL_EFR32ZG13P531F512GM32
    bool
    select CPU_FAM_EFR32ZG13P

config CPU_MODEL_EFR32ZG13P231F512GM64
    bool
    select CPU_FAM_EFR32ZG13P

config CPU_MODEL_EFR32ZG13P531F512GM48
    bool
    select CPU_FAM_EFR32ZG13P

## Common CPU symbols
config CPU_FAM
    default "efr32zg13p" if CPU_FAM_EFR32ZG13P

config CPU_MODEL
    default "efr32zg13p531f512gm32" if CPU_MODEL_EFR32ZG13P531F512GM32
    default "efr32zg13p231f512gm64" if CPU_MODEL_EFR32ZG13P231F512GM64
    default "efr32zg13p531f512gm48" if CPU_MODEL_EFR32ZG13P531F512GM48
```

## dist/cpu/efm32/families/efr32zg14p/Kconfig
```kconfig
# Copyright (c) 2020 HAW Hamburg
#
# This file is subject to the terms and conditions of the GNU Lesser
# General Public License v2.1. See the file LICENSE in the top level
# directory for more details.

config CPU_FAM_EFR32ZG14P
    bool
    select CPU_CORE_CORTEX_M4F
    select CPU_COMMON_EFM32
    select HAS_PERIPH_HWRNG

## CPU Models
config CPU_MODEL_EFR32ZG14P231F256GM32
    bool
    select CPU_FAM_EFR32ZG14P

## Common CPU symbols
config CPU_FAM
    default "efr32zg14p" if CPU_FAM_EFR32ZG14P

config CPU_MODEL
    default "efr32zg14p231f256gm32" if CPU_MODEL_EFR32ZG14P231F256GM32
```

## efm2riot/templates/cpu/efm32/families/family/Kconfig
```kconfig
# Copyright (c) 2020 HAW Hamburg
#
# This file is subject to the terms and conditions of the GNU Lesser
# General Public License v2.1. See the file LICENSE in the top level
# directory for more details.

config CPU_FAM_{{ family|upper }}
    bool
    select CPU_CORE_CORTEX_{{ architecture|upper }}
    select CPU_COMMON_EFM32
    select CPU_EFM32_SERIES{{ cpu_series }}
    {% strip 2 %}
        {% if trng %}
            select HAS_PERIPH_HWRNG
        {% endif %}
    {% endstrip %}
    {% strip 2 %}
        {% if mpu %}
            select HAS_CORTEXM_MPU
        {% endif %}
    {% endstrip %}

## CPU Models
{% strip 2 %}
    {% for cpu in cpus %}
        config CPU_MODEL_{{ cpu.cpu|upper }}
            bool
            select CPU_FAM_{{ family|upper }}

    {% endfor %}
{% endstrip -%}

## Common CPU symbols
config CPU_FAM
    default "{{ family }}" if CPU_FAM_{{ family|upper }}

config CPU_MODEL
    {% strip 3 %}
        {% align_with "if" %}
            {% for cpu in cpus %}
                default "{{ cpu.cpu }}" if CPU_MODEL_{{ cpu.cpu|upper }}
            {% endfor %}
        {% endalign_with %}
    {% endstrip %}
```
