## dist-development/boards/slwstk6000b/Kconfig
```kconfig
# Copyright (c) 2020 HAW Hamburg
#
# This file is subject to the terms and conditions of the GNU Lesser
# General Public License v2.1. See the file LICENSE in the top level
# directory for more details.

config BOARD
    default "slwstk6000b" if BOARD_SLWSTK6000B

config BOARD_SLWSTK6000B
    bool
    default y
    select BOARD_COMMON_SILABS
    select CPU_MODEL_EFR32MG12P332F1024GL125
    select HAS_PERIPH_ADC
    select HAS_PERIPH_I2C
    select HAS_PERIPH_RTC
    select HAS_PERIPH_RTT
    select HAS_PERIPH_SPI
    select HAS_PERIPH_TIMER
    select HAS_PERIPH_UART
    select HAS_PERIPH_UART_MODECFG

source "$(RIOTBOARD)/common/silabs/Kconfig"
```

## dist-development/cpu/efm32/families/efm32g/Kconfig
```kconfig
# Copyright (c) 2020 HAW Hamburg
#
# This file is subject to the terms and conditions of the GNU Lesser
# General Public License v2.1. See the file LICENSE in the top level
# directory for more details.

config CPU_FAM_EFM32G
    bool
    select CPU_CORE_CORTEX_M3
    select CPU_COMMON_EFM32
    select CPU_EFM32_SERIES0
    select HAS_CORTEXM_MPU

## CPU Models
config CPU_MODEL_EFM32G842F32
    bool
    select CPU_FAM_EFM32G

config CPU_MODEL_EFM32G800F128
    bool
    select CPU_FAM_EFM32G

config CPU_MODEL_EFM32G200F64
    bool
    select CPU_FAM_EFM32G

config CPU_MODEL_EFM32G232F32
    bool
    select CPU_FAM_EFM32G

config CPU_MODEL_EFM32G280F128
    bool
    select CPU_FAM_EFM32G

config CPU_MODEL_EFM32G290F32
    bool
    select CPU_FAM_EFM32G

config CPU_MODEL_EFM32G880F32
    bool
    select CPU_FAM_EFM32G

config CPU_MODEL_EFM32G230F64
    bool
    select CPU_FAM_EFM32G

config CPU_MODEL_EFM32G280F32
    bool
    select CPU_FAM_EFM32G

config CPU_MODEL_EFM32G840F128
    bool
    select CPU_FAM_EFM32G

config CPU_MODEL_EFM32G880F128
    bool
    select CPU_FAM_EFM32G

config CPU_MODEL_EFM32G222F128
    bool
    select CPU_FAM_EFM32G

config CPU_MODEL_EFM32G200F16
    bool
    select CPU_FAM_EFM32G

config CPU_MODEL_EFM32G890F32
    bool
    select CPU_FAM_EFM32G

config CPU_MODEL_EFM32G840F64
    bool
    select CPU_FAM_EFM32G

config CPU_MODEL_EFM32G222F32
    bool
    select CPU_FAM_EFM32G

config CPU_MODEL_EFM32G842F128
    bool
    select CPU_FAM_EFM32G

config CPU_MODEL_EFM32G290F64
    bool
    select CPU_FAM_EFM32G

config CPU_MODEL_EFM32G880F64
    bool
    select CPU_FAM_EFM32G

config CPU_MODEL_EFM32G232F64
    bool
    select CPU_FAM_EFM32G

config CPU_MODEL_EFM32G200F32
    bool
    select CPU_FAM_EFM32G

config CPU_MODEL_EFM32G290F128
    bool
    select CPU_FAM_EFM32G

config CPU_MODEL_EFM32G842F64
    bool
    select CPU_FAM_EFM32G

config CPU_MODEL_EFM32G840F32
    bool
    select CPU_FAM_EFM32G

config CPU_MODEL_EFM32G222F64
    bool
    select CPU_FAM_EFM32G

config CPU_MODEL_EFM32G280F64
    bool
    select CPU_FAM_EFM32G

config CPU_MODEL_EFM32G210F128
    bool
    select CPU_FAM_EFM32G

config CPU_MODEL_EFM32G890F64
    bool
    select CPU_FAM_EFM32G

config CPU_MODEL_EFM32G230F128
    bool
    select CPU_FAM_EFM32G

config CPU_MODEL_EFM32G230F32
    bool
    select CPU_FAM_EFM32G

config CPU_MODEL_EFM32G232F128
    bool
    select CPU_FAM_EFM32G

config CPU_MODEL_EFM32G890F128
    bool
    select CPU_FAM_EFM32G

## Common CPU symbols
config CPU_FAM
    default "efm32g" if CPU_FAM_EFM32G

config CPU_MODEL
    default "efm32g842f32"  if CPU_MODEL_EFM32G842F32
    default "efm32g800f128" if CPU_MODEL_EFM32G800F128
    default "efm32g200f64"  if CPU_MODEL_EFM32G200F64
    default "efm32g232f32"  if CPU_MODEL_EFM32G232F32
    default "efm32g280f128" if CPU_MODEL_EFM32G280F128
    default "efm32g290f32"  if CPU_MODEL_EFM32G290F32
    default "efm32g880f32"  if CPU_MODEL_EFM32G880F32
    default "efm32g230f64"  if CPU_MODEL_EFM32G230F64
    default "efm32g280f32"  if CPU_MODEL_EFM32G280F32
    default "efm32g840f128" if CPU_MODEL_EFM32G840F128
    default "efm32g880f128" if CPU_MODEL_EFM32G880F128
    default "efm32g222f128" if CPU_MODEL_EFM32G222F128
    default "efm32g200f16"  if CPU_MODEL_EFM32G200F16
    default "efm32g890f32"  if CPU_MODEL_EFM32G890F32
    default "efm32g840f64"  if CPU_MODEL_EFM32G840F64
    default "efm32g222f32"  if CPU_MODEL_EFM32G222F32
    default "efm32g842f128" if CPU_MODEL_EFM32G842F128
    default "efm32g290f64"  if CPU_MODEL_EFM32G290F64
    default "efm32g880f64"  if CPU_MODEL_EFM32G880F64
    default "efm32g232f64"  if CPU_MODEL_EFM32G232F64
    default "efm32g200f32"  if CPU_MODEL_EFM32G200F32
    default "efm32g290f128" if CPU_MODEL_EFM32G290F128
    default "efm32g842f64"  if CPU_MODEL_EFM32G842F64
    default "efm32g840f32"  if CPU_MODEL_EFM32G840F32
    default "efm32g222f64"  if CPU_MODEL_EFM32G222F64
    default "efm32g280f64"  if CPU_MODEL_EFM32G280F64
    default "efm32g210f128" if CPU_MODEL_EFM32G210F128
    default "efm32g890f64"  if CPU_MODEL_EFM32G890F64
    default "efm32g230f128" if CPU_MODEL_EFM32G230F128
    default "efm32g230f32"  if CPU_MODEL_EFM32G230F32
    default "efm32g232f128" if CPU_MODEL_EFM32G232F128
    default "efm32g890f128" if CPU_MODEL_EFM32G890F128
```

## dist-development/cpu/efm32/families/efm32tg/Kconfig
```kconfig
# Copyright (c) 2020 HAW Hamburg
#
# This file is subject to the terms and conditions of the GNU Lesser
# General Public License v2.1. See the file LICENSE in the top level
# directory for more details.

config CPU_FAM_EFM32TG
    bool
    select CPU_CORE_CORTEX_M3
    select CPU_COMMON_EFM32
    select CPU_EFM32_SERIES0

## CPU Models
config CPU_MODEL_EFM32TG108F4
    bool
    select CPU_FAM_EFM32TG

config CPU_MODEL_EFM32TG222F32
    bool
    select CPU_FAM_EFM32TG

config CPU_MODEL_EFM32TG822F8
    bool
    select CPU_FAM_EFM32TG

config CPU_MODEL_EFM32TG210F8
    bool
    select CPU_FAM_EFM32TG

config CPU_MODEL_EFM32TG110F32
    bool
    select CPU_FAM_EFM32TG

config CPU_MODEL_EFM32TG825F8
    bool
    select CPU_FAM_EFM32TG

config CPU_MODEL_EFM32TG825F32
    bool
    select CPU_FAM_EFM32TG

config CPU_MODEL_EFM32TG108F16
    bool
    select CPU_FAM_EFM32TG

config CPU_MODEL_EFM32TG842F8
    bool
    select CPU_FAM_EFM32TG

config CPU_MODEL_EFM32TG210F16
    bool
    select CPU_FAM_EFM32TG

config CPU_MODEL_EFM32TG232F32
    bool
    select CPU_FAM_EFM32TG

config CPU_MODEL_EFM32TG230F16
    bool
    select CPU_FAM_EFM32TG

config CPU_MODEL_EFM32TG840F8
    bool
    select CPU_FAM_EFM32TG

config CPU_MODEL_EFM32TG822F32
    bool
    select CPU_FAM_EFM32TG

config CPU_MODEL_EFM32TG110F8
    bool
    select CPU_FAM_EFM32TG

config CPU_MODEL_EFM32TG225F32
    bool
    select CPU_FAM_EFM32TG

config CPU_MODEL_EFM32TG842F32
    bool
    select CPU_FAM_EFM32TG

config CPU_MODEL_EFM32TG840F16
    bool
    select CPU_FAM_EFM32TG

config CPU_MODEL_EFM32TG210F32
    bool
    select CPU_FAM_EFM32TG

config CPU_MODEL_EFM32TG108F8
    bool
    select CPU_FAM_EFM32TG

config CPU_MODEL_EFM32TG822F16
    bool
    select CPU_FAM_EFM32TG

config CPU_MODEL_EFM32TG232F16
    bool
    select CPU_FAM_EFM32TG

config CPU_MODEL_EFM32TG230F32
    bool
    select CPU_FAM_EFM32TG

config CPU_MODEL_EFM32TG225F16
    bool
    select CPU_FAM_EFM32TG

config CPU_MODEL_EFM32TG842F16
    bool
    select CPU_FAM_EFM32TG

config CPU_MODEL_EFM32TG840F32
    bool
    select CPU_FAM_EFM32TG

config CPU_MODEL_EFM32TG222F8
    bool
    select CPU_FAM_EFM32TG

config CPU_MODEL_EFM32TG222F16
    bool
    select CPU_FAM_EFM32TG

config CPU_MODEL_EFM32TG110F16
    bool
    select CPU_FAM_EFM32TG

config CPU_MODEL_EFM32TG230F8
    bool
    select CPU_FAM_EFM32TG

config CPU_MODEL_EFM32TG225F8
    bool
    select CPU_FAM_EFM32TG

config CPU_MODEL_EFM32TG110F4
    bool
    select CPU_FAM_EFM32TG

config CPU_MODEL_EFM32TG108F32
    bool
    select CPU_FAM_EFM32TG

config CPU_MODEL_EFM32TG232F8
    bool
    select CPU_FAM_EFM32TG

config CPU_MODEL_EFM32TG825F16
    bool
    select CPU_FAM_EFM32TG

## Common CPU symbols
config CPU_FAM
    default "efm32tg" if CPU_FAM_EFM32TG

config CPU_MODEL
    default "efm32tg108f4"  if CPU_MODEL_EFM32TG108F4
    default "efm32tg222f32" if CPU_MODEL_EFM32TG222F32
    default "efm32tg822f8"  if CPU_MODEL_EFM32TG822F8
    default "efm32tg210f8"  if CPU_MODEL_EFM32TG210F8
    default "efm32tg110f32" if CPU_MODEL_EFM32TG110F32
    default "efm32tg825f8"  if CPU_MODEL_EFM32TG825F8
    default "efm32tg825f32" if CPU_MODEL_EFM32TG825F32
    default "efm32tg108f16" if CPU_MODEL_EFM32TG108F16
    default "efm32tg842f8"  if CPU_MODEL_EFM32TG842F8
    default "efm32tg210f16" if CPU_MODEL_EFM32TG210F16
    default "efm32tg232f32" if CPU_MODEL_EFM32TG232F32
    default "efm32tg230f16" if CPU_MODEL_EFM32TG230F16
    default "efm32tg840f8"  if CPU_MODEL_EFM32TG840F8
    default "efm32tg822f32" if CPU_MODEL_EFM32TG822F32
    default "efm32tg110f8"  if CPU_MODEL_EFM32TG110F8
    default "efm32tg225f32" if CPU_MODEL_EFM32TG225F32
    default "efm32tg842f32" if CPU_MODEL_EFM32TG842F32
    default "efm32tg840f16" if CPU_MODEL_EFM32TG840F16
    default "efm32tg210f32" if CPU_MODEL_EFM32TG210F32
    default "efm32tg108f8"  if CPU_MODEL_EFM32TG108F8
    default "efm32tg822f16" if CPU_MODEL_EFM32TG822F16
    default "efm32tg232f16" if CPU_MODEL_EFM32TG232F16
    default "efm32tg230f32" if CPU_MODEL_EFM32TG230F32
    default "efm32tg225f16" if CPU_MODEL_EFM32TG225F16
    default "efm32tg842f16" if CPU_MODEL_EFM32TG842F16
    default "efm32tg840f32" if CPU_MODEL_EFM32TG840F32
    default "efm32tg222f8"  if CPU_MODEL_EFM32TG222F8
    default "efm32tg222f16" if CPU_MODEL_EFM32TG222F16
    default "efm32tg110f16" if CPU_MODEL_EFM32TG110F16
    default "efm32tg230f8"  if CPU_MODEL_EFM32TG230F8
    default "efm32tg225f8"  if CPU_MODEL_EFM32TG225F8
    default "efm32tg110f4"  if CPU_MODEL_EFM32TG110F4
    default "efm32tg108f32" if CPU_MODEL_EFM32TG108F32
    default "efm32tg232f8"  if CPU_MODEL_EFM32TG232F8
    default "efm32tg825f16" if CPU_MODEL_EFM32TG825F16
```

## dist-development/cpu/efm32/families/efr32bg14p/Kconfig
```kconfig
# Copyright (c) 2020 HAW Hamburg
#
# This file is subject to the terms and conditions of the GNU Lesser
# General Public License v2.1. See the file LICENSE in the top level
# directory for more details.

config CPU_FAM_EFR32BG14P
    bool
    select CPU_CORE_CORTEX_M4F
    select CPU_COMMON_EFM32
    select CPU_EFM32_SERIES1
    select HAS_PERIPH_HWRNG
    select HAS_CORTEXM_MPU

## CPU Models
config CPU_MODEL_EFR32BG14P732F256GM32
    bool
    select CPU_FAM_EFR32BG14P

config CPU_MODEL_EFR32BG14P532F256GM48
    bool
    select CPU_FAM_EFR32BG14P

config CPU_MODEL_EFR32BG14P632F256GM48
    bool
    select CPU_FAM_EFR32BG14P

config CPU_MODEL_EFR32BG14P632F256IM32
    bool
    select CPU_FAM_EFR32BG14P

config CPU_MODEL_EFR32BG14P632F256IM48
    bool
    select CPU_FAM_EFR32BG14P

config CPU_MODEL_EFR32BG14P733F256GM48
    bool
    select CPU_FAM_EFR32BG14P

config CPU_MODEL_EFR32BG14P632F256GM32
    bool
    select CPU_FAM_EFR32BG14P

config CPU_MODEL_EFR32BG14P532F256GM32
    bool
    select CPU_FAM_EFR32BG14P

config CPU_MODEL_EFR32BG14P732F256GM48
    bool
    select CPU_FAM_EFR32BG14P

## Common CPU symbols
config CPU_FAM
    default "efr32bg14p" if CPU_FAM_EFR32BG14P

config CPU_MODEL
    default "efr32bg14p732f256gm32" if CPU_MODEL_EFR32BG14P732F256GM32
    default "efr32bg14p532f256gm48" if CPU_MODEL_EFR32BG14P532F256GM48
    default "efr32bg14p632f256gm48" if CPU_MODEL_EFR32BG14P632F256GM48
    default "efr32bg14p632f256im32" if CPU_MODEL_EFR32BG14P632F256IM32
    default "efr32bg14p632f256im48" if CPU_MODEL_EFR32BG14P632F256IM48
    default "efr32bg14p733f256gm48" if CPU_MODEL_EFR32BG14P733F256GM48
    default "efr32bg14p632f256gm32" if CPU_MODEL_EFR32BG14P632F256GM32
    default "efr32bg14p532f256gm32" if CPU_MODEL_EFR32BG14P532F256GM32
    default "efr32bg14p732f256gm48" if CPU_MODEL_EFR32BG14P732F256GM48
```

## dist-development/cpu/efm32/families/efr32bg1b/Kconfig
```kconfig
# Copyright (c) 2020 HAW Hamburg
#
# This file is subject to the terms and conditions of the GNU Lesser
# General Public License v2.1. See the file LICENSE in the top level
# directory for more details.

config CPU_FAM_EFR32BG1B
    bool
    select CPU_CORE_CORTEX_M4F
    select CPU_COMMON_EFM32

## CPU Models
config CPU_MODEL_EFR32BG1B132F128GM48
    bool
    select CPU_FAM_EFR32BG1B

config CPU_MODEL_EFR32BG1B232F256GM48
    bool
    select CPU_FAM_EFR32BG1B

config CPU_MODEL_EFR32BG1B232F256GM56
    bool
    select CPU_FAM_EFR32BG1B

config CPU_MODEL_EFR32BG1B232F256IM32
    bool
    select CPU_FAM_EFR32BG1B

config CPU_MODEL_EFR32BG1B132F256IM32
    bool
    select CPU_FAM_EFR32BG1B

config CPU_MODEL_EFR32BG1B132F256GM56
    bool
    select CPU_FAM_EFR32BG1B

config CPU_MODEL_EFR32BG1B132F256GD32
    bool
    select CPU_FAM_EFR32BG1B

config CPU_MODEL_EFR32BG1B132F256GM48
    bool
    select CPU_FAM_EFR32BG1B

config CPU_MODEL_EFR32BG1B232F128GM48
    bool
    select CPU_FAM_EFR32BG1B

config CPU_MODEL_EFR32BG1B232F128GJ43
    bool
    select CPU_FAM_EFR32BG1B

config CPU_MODEL_EFR32BG1B132F256GJ43
    bool
    select CPU_FAM_EFR32BG1B

config CPU_MODEL_EFR32BG1B132F256GM32
    bool
    select CPU_FAM_EFR32BG1B

config CPU_MODEL_EFR32BG1B232F128GM32
    bool
    select CPU_FAM_EFR32BG1B

config CPU_MODEL_EFR32BG1B132F128GM32
    bool
    select CPU_FAM_EFR32BG1B

config CPU_MODEL_EFR32BG1B232F256GM32
    bool
    select CPU_FAM_EFR32BG1B

config CPU_MODEL_EFR32BG1B232F256GJ43
    bool
    select CPU_FAM_EFR32BG1B

config CPU_MODEL_EFR32BG1B132F128GJ43
    bool
    select CPU_FAM_EFR32BG1B

## Common CPU symbols
config CPU_FAM
    default "efr32bg1b" if CPU_FAM_EFR32BG1B

config CPU_MODEL
    default "efr32bg1b132f128gm48" if CPU_MODEL_EFR32BG1B132F128GM48
    default "efr32bg1b232f256gm48" if CPU_MODEL_EFR32BG1B232F256GM48
    default "efr32bg1b232f256gm56" if CPU_MODEL_EFR32BG1B232F256GM56
    default "efr32bg1b232f256im32" if CPU_MODEL_EFR32BG1B232F256IM32
    default "efr32bg1b132f256im32" if CPU_MODEL_EFR32BG1B132F256IM32
    default "efr32bg1b132f256gm56" if CPU_MODEL_EFR32BG1B132F256GM56
    default "efr32bg1b132f256gd32" if CPU_MODEL_EFR32BG1B132F256GD32
    default "efr32bg1b132f256gm48" if CPU_MODEL_EFR32BG1B132F256GM48
    default "efr32bg1b232f128gm48" if CPU_MODEL_EFR32BG1B232F128GM48
    default "efr32bg1b232f128gj43" if CPU_MODEL_EFR32BG1B232F128GJ43
    default "efr32bg1b132f256gj43" if CPU_MODEL_EFR32BG1B132F256GJ43
    default "efr32bg1b132f256gm32" if CPU_MODEL_EFR32BG1B132F256GM32
    default "efr32bg1b232f128gm32" if CPU_MODEL_EFR32BG1B232F128GM32
    default "efr32bg1b132f128gm32" if CPU_MODEL_EFR32BG1B132F128GM32
    default "efr32bg1b232f256gm32" if CPU_MODEL_EFR32BG1B232F256GM32
    default "efr32bg1b232f256gj43" if CPU_MODEL_EFR32BG1B232F256GJ43
    default "efr32bg1b132f128gj43" if CPU_MODEL_EFR32BG1B132F128GJ43
```
